## arch/arm/mach-s5p6442/Kconfig
```kconfig
# SPDX-License-Identifier: GPL-2.0
#
# Copyright (c) 2010 Samsung Electronics Co., Ltd.
#		http://www.samsung.com/

# Configuration options for the S5PV210/S5PC110

config ARCH_S5P6442
	bool "Samsung S5P6442"
	depends on ARCH_MULTI_V6
	select ARM_VIC
	select CLKSRC_SAMSUNG_PWM
	select COMMON_CLK_SAMSUNG
	select GPIOLIB
	select PINCTRL
	select PINCTRL_S3C64XX
	select SOC_SAMSUNG
	help
	  Samsung S5P6442 based systems

if ARCH_S5P6442

config CPU_S5P6442
	def_bool y
	select ARM_AMBA
	select PL330_DMA if DMADEVICES
	help
	  Enable S5P6442 CPU support

endif
```

## arch/arm/mach-s5pv210/Kconfig
```kconfig
# SPDX-License-Identifier: GPL-2.0
#
# Copyright (c) 2010 Samsung Electronics Co., Ltd.
#		http://www.samsung.com/

# Configuration options for the S5PV210/S5PC110

config ARCH_S5PV210
	bool "Samsung S5PV210/S5PC110/S5P6442"
	depends on ARCH_MULTI_V7 || ARCH_MULTI_V6
	select ARM_VIC
	select CLKSRC_SAMSUNG_PWM
	select COMMON_CLK_SAMSUNG
	select GPIOLIB
	select PINCTRL
	select PINCTRL_EXYNOS
	select SOC_SAMSUNG
	help
	  Samsung S5PV210/S5PC110/S5P6442 series based systems

if ARCH_S5PV210

config CPU_S5PV210
	def_bool y
	depends on !ARCH_MULTI_V6
	select ARM_AMBA
	select PL330_DMA if DMADEVICES
	help
	  Enable S5PV210 CPU support

config CPU_S5P6442
	def_bool y
	depends on !ARCH_MULTI_V7
	select ARM_AMBA
	select PL330_DMA if DMADEVICES
	help
	  Enable S5P6442 CPU support
	  Samsung S5P6442 is loosely based on the S5PV210 SoC

endif
```
